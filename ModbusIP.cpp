/*
    ModbusIP.cpp - Source for Modbus IP Library
    Copyright (C) 2015 André Sarmento Barbosa

	Add support for RS485 relay (by Frederic RIBLE)
*/
#include "ModbusIP.h"

ModbusIP::ModbusIP():_server(MODBUSIP_PORT) {
	this->_slaveId= 1;
	this->_SerialInProgress = false;
	this->client = NULL;
	this->ModbusTimeout_ms = 200;
}

void ModbusIP::config() {
	_server.begin();
}

void ModbusIP::config(uint8_t *mac) {
    Ethernet.begin(mac);
    _server.begin();
}

void ModbusIP::config(uint8_t *mac, IPAddress ip) {
    Ethernet.begin(mac, ip);
    _server.begin();
}

void ModbusIP::config(uint8_t *mac, IPAddress ip, IPAddress dns) {
    Ethernet.begin(mac, ip, dns);
    _server.begin();
}

void ModbusIP::config(uint8_t *mac, IPAddress ip, IPAddress dns, IPAddress gateway) {
    Ethernet.begin(mac, ip, dns, gateway);
    _server.begin();
}

void ModbusIP::config(uint8_t *mac, IPAddress ip, IPAddress dns, IPAddress gateway, IPAddress subnet) {
    Ethernet.begin(mac, ip, dns, gateway, subnet);
    _server.begin();
}

void ModbusIP::configRelay(HardwareSerial* port, long baud, u_int format, void (*_switch_txrx)(txrx_mode)) {
	this->_port = port;
	port->begin(baud, format);
	this->_switch_txrx = _switch_txrx;

	if (baud > 19200) {
		_t15 = 750;
		_t35 = 1750;
	} 
	else {
		_t15 = 15000000/baud; // 1T * 1.5 = T1.5
		_t35 = 35000000/baud; // 1T * 3.5 = T3.5
	}
}

void ModbusIP::task() 
{
	if (!_SerialInProgress) pollTCP();
	else pollSerial();
}

void ModbusIP::pollTCP() 
{
    client = _server.available();

    if (client) {
        if (client.connected()) {
            int i = 0;
            while (client.available()){
                _MBAP[i] = client.read();
                i++;
                if (i==7) break;  //MBAP length has 7 bytes size
            }
            _len = _MBAP[4] << 8 | _MBAP[5];
            _len--;  // Do not count with last byte from MBAP

            if (_MBAP[2] !=0 || _MBAP[3] !=0) return;   //Not a MODBUSIP packet
            if (_len > MODBUSIP_MAXFRAME) return;      //Length is over MODBUSIP_MAXFRAME

            _frame = (byte*) malloc(_len);
            i = 0;
            while (client.available()){
                _frame[i] = client.read();
                i++;
                if (i==_len) break;
            }

			if (_MBAP[6] == this->_slaveId) {	// This MODBUS frame is for us
				this->receivePDU(_frame);
				if (_reply != MB_REPLY_OFF) {
					//MBAP
					_MBAP[4] = (_len+1) >> 8;     //_len+1 for last byte from MBAP
					_MBAP[5] = (_len+1) & 0x00FF;

					byte sendbuffer[7 + _len];

					for (i = 0 ; i < 7 ; i++) {
						sendbuffer[i] = _MBAP[i];
					}
					//PDU Frame
					for (i = 0 ; i < _len ; i++) {
						sendbuffer[i+7] = _frame[i];
					}
					client.write(sendbuffer, _len + 7);
				}
			}
			else {	// Relay over RS485 Serial line
				TCP2Serial_Relay();
				_timeoutTransaction = micros() + ModbusTimeout_ms * 1000L;
				_timeoutFrame = 0;
				_SerialInProgress = true;
			}
#ifndef TCP_KEEP_ALIVE
            client.stop();
#endif
            free(_frame);
            _len = 0;
        }
    }
}

void ModbusIP::pollSerial()
{
	if (micros() > _timeoutTransaction) {
		_len = 0;
		_SerialInProgress = false;
		while (_port->available()) _port->read();
		// Switch off receiver
		_switch_txrx(off);
		return;
	}

    if (_port->available() > _len)	{	// We have received new data
	    _len = _port->available();
		_timeoutFrame = micros() + _t35;
    }
	else if (_len > 0 && micros() > _timeoutFrame) {
		//Serial.println(_len);
		if (_len >= 3) {
			byte i;
			_MBAP[6] = _port->read();
			_len--;
			if (_MBAP[6] == 0 && _len > 0) {	// Remove random parasitic zero after remote switch TX on
				_MBAP[6] = _port->read();
				_len--;				
			}
			_frame = (byte*) malloc(_len);
			for (i=0 ; i < _len ; i++) {
				_frame[i] = _port->read();
			}
			if (client) Serial2TCP_Relay();
			free(_frame);
		}
		while (_port->available()) _port->read();
		_len = 0;	
		_SerialInProgress = false;
		// Switch off receiver
		_switch_txrx(off);
	}
}

bool ModbusIP::TCP2Serial_Relay() 
{
	// Switch to TX mode
	_switch_txrx(tx);
	
	//Send slaveId
	_port->write(_MBAP[6]);

	//Send PDU
	byte i;
	for (i = 0 ; i < _len ; i++) {
		_port->write(_frame[i]);
	}

	//Send CRC
	word crc = calcCrc(_MBAP[6], _frame, _len);
	_port->write(crc >> 8);
	_port->write(crc & 0xFF);

	_port->flush();
	delayMicroseconds(_t35);

	// Switch to RX mode
	_switch_txrx(rx);
}

bool ModbusIP::Serial2TCP_Relay() 
{
	//Last two bytes = crc
	u_int crc = ((_frame[_len - 2] << 8) | _frame[_len - 1]);

	//CRC Check
	if (crc != this->calcCrc(_MBAP[6], _frame, _len-2)) {
		return false;
	}

	_len -= 2; // remove CRC
	
	//MBAP
	_MBAP[4] = (_len+1) >> 8;     //_len+1 for last byte from MBAP
	_MBAP[5] = (_len+1) & 0x00FF;
	
	byte sendbuffer[7 + _len];

	for (int i = 0 ; i < 7 ; i++) {
		sendbuffer[i] = _MBAP[i];
	}
	//PDU Frame
	for (int i = 0 ; i < _len ; i++) {
		sendbuffer[i+7] = _frame[i];
	}
	client.write(sendbuffer, _len + 7);
	return true;
}

/* Table of CRC values for high–order byte */
const byte _auchCRCHi[] = {
	0x00, 0xC1, 0x81, 0x40, 0x01, 0xC0, 0x80, 0x41, 0x01, 0xC0, 0x80, 0x41, 0x00, 0xC1, 0x81,
	0x40, 0x01, 0xC0, 0x80, 0x41, 0x00, 0xC1, 0x81, 0x40, 0x00, 0xC1, 0x81, 0x40, 0x01, 0xC0,
	0x80, 0x41, 0x01, 0xC0, 0x80, 0x41, 0x00, 0xC1, 0x81, 0x40, 0x00, 0xC1, 0x81, 0x40, 0x01,
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	0x00, 0xC1, 0x81, 0x40, 0x01, 0xC0, 0x80, 0x41, 0x01, 0xC0, 0x80, 0x41, 0x00, 0xC1, 0x81,
0x40};

/* Table of CRC values for low–order byte */
const byte _auchCRCLo[] = {
	0x00, 0xC0, 0xC1, 0x01, 0xC3, 0x03, 0x02, 0xC2, 0xC6, 0x06, 0x07, 0xC7, 0x05, 0xC5, 0xC4,
	0x04, 0xCC, 0x0C, 0x0D, 0xCD, 0x0F, 0xCF, 0xCE, 0x0E, 0x0A, 0xCA, 0xCB, 0x0B, 0xC9, 0x09,
	0x08, 0xC8, 0xD8, 0x18, 0x19, 0xD9, 0x1B, 0xDB, 0xDA, 0x1A, 0x1E, 0xDE, 0xDF, 0x1F, 0xDD,
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	0x44, 0x84, 0x85, 0x45, 0x87, 0x47, 0x46, 0x86, 0x82, 0x42, 0x43, 0x83, 0x41, 0x81, 0x80,
0x40};

word ModbusIP::calcCrc(byte address, byte* pduFrame, byte pduLen) {
	byte CRCHi = 0xFF, CRCLo = 0x0FF, Index;

	Index = CRCHi ^ address;
	CRCHi = CRCLo ^ _auchCRCHi[Index];
	CRCLo = _auchCRCLo[Index];

	while (pduLen--) {
		Index = CRCHi ^ *pduFrame++;
		CRCHi = CRCLo ^ _auchCRCHi[Index];
		CRCLo = _auchCRCLo[Index];
	}

	return (CRCHi << 8) | CRCLo;
}